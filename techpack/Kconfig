## techpack/Kconfig
```kconfig
menu "Tech packages"

config TECHPACK_XIAOMI_CAMERA
    bool "Xiaomi techpack camera default"

config TECHPACK_XIAOMI_CAMERA_CAS
    bool "Xiaomi techpack camera cas config"

config TECHPACK_XIAOMI_CAS_PATCH
    bool "Xiaomi techpack cas camera patch"

config TECHPACK_XIAOMI_FOD_PATCH
    bool "Xiaomi techpack display FOD patch"

source "techpack/data/Kconfig"

menu "Camera packages"

config TECHPACK_CAMERA_XIAOMI
    bool "Xiaomi camera"
    help
      Xiaomi camera

config TECHPACK_CAMERA_XIAOMI_PSYCHE
    bool "Xiaomi camera psyche"
    help
      Xiaomi camera psyche

config TECHPACK_CAMERA_XIAOMI_CAS
    bool "Xiaomi camera CAS"
    help
      Xiaomi camera CAS

config TECHPACK_CAMERA_XIAOMI_TABLET
    bool "Xiaomi camera tablet"
    help
      Xiaomi camera tablet

endmenu

endmenu
```
